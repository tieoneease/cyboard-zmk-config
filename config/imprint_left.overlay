#include <input/processors.dtsi>
#include <dt-bindings/zmk/input_transform.h>

/ {
    trackball_scroll_listener: trackball_scroll_listener {
        compatible = "zmk,input-listener";
        device = <&trackball_central>;
        input-processors =
            <&zip_xy_scaler 1 3>,
            <&zip_xy_to_scroll_mapper>,
            <&zip_scroll_transform INPUT_TRANSFORM_Y_INVERT>;
        layers = <7>;
    };
};
